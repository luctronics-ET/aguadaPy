## firmware/gateway_wifi/sdkconfig.defaults
```kconfig
# Configuração ESP-IDF para Gateway WiFi

# Otimizações
CONFIG_COMPILER_OPTIMIZATION_SIZE=y
CONFIG_BOOTLOADER_LOG_LEVEL_WARN=y

# WiFi
CONFIG_ESP_WIFI_STATIC_RX_BUFFER_NUM=8
CONFIG_ESP_WIFI_DYNAMIC_RX_BUFFER_NUM=16
CONFIG_ESP_WIFI_DYNAMIC_TX_BUFFER_NUM=16
CONFIG_ESP_WIFI_AMPDU_TX_ENABLED=y
CONFIG_ESP_WIFI_AMPDU_RX_ENABLED=y

# ESP-NOW
CONFIG_ESP_WIFI_ESPNOW_MAX_ENCRYPT_NUM=0

# FreeRTOS
CONFIG_FREERTOS_HZ=1000
CONFIG_FREERTOS_UNICORE=y

# Log
CONFIG_LOG_DEFAULT_LEVEL_INFO=y
CONFIG_LOG_COLORS=y

# HTTP Client
CONFIG_ESP_HTTP_CLIENT_ENABLE_HTTPS=n
```

## firmware/node-04-dual/sdkconfig.defaults
```kconfig
# Node Aguada 01 defaults (ESP32-C3)
CONFIG_IDF_TARGET="esp32c3"
CONFIG_ESPTOOLPY_FLASHFREQ_80M=y
CONFIG_ESPTOOLPY_FLASHMODE_DIO=y
CONFIG_ESPTOOLPY_FLASHSIZE_2MB=y
CONFIG_BOOTLOADER_COMPILER_OPTIMIZATION_SIZE=y
```
